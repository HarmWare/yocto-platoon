## meta-harmony/meta-apps/conf/layer.conf
```bitbake
# We have a conf and classes directory, add to BBPATH
BBPATH .= ":${LAYERDIR}"

# We have recipes-* directories, add to BBFILES
BBFILES += "${LAYERDIR}/recipes-*/*/*.bb \
            ${LAYERDIR}/recipes-*/*/*.bbappend"

BBFILE_COLLECTIONS += "meta-apps"
BBFILE_PATTERN_meta-apps = "^${LAYERDIR}/"
BBFILE_PRIORITY_meta-apps = "6"

LAYERDEPENDS_meta-apps = "core"
LAYERSERIES_COMPAT_meta-apps = "kirkstone"
```

## meta-harmony/meta-harmonyOS/conf/distro/harmonyOS.conf
```bitbake
# Distro Layer configuration
# include and overwrite default poky distro
include conf/distro/poky.conf
DISTRO = "harmonyOS"
DISTRO_NAME = "harmonyOS"
DISTRO_VERSION = "1.0"

DISTRO_FEATURES:append = " opengl eglfs"
DISTRO_FEATURES:remove = " x11 wayland"

# Use systemd as init manager
INIT_MANAGER = "systemd"
```

## meta-harmony/meta-harmonyOS/conf/layer.conf
```bitbake
# We have a conf and classes directory, add to BBPATH
BBPATH .= ":${LAYERDIR}"

# We have recipes-* directories, add to BBFILES
BBFILES += "${LAYERDIR}/recipes-*/*/*.bb \
            ${LAYERDIR}/recipes-*/*/*.bbappend"

BBFILE_COLLECTIONS += "meta-harmonyOS"
BBFILE_PATTERN_meta-harmonyOS = "^${LAYERDIR}/"
BBFILE_PRIORITY_meta-harmonyOS = "6"

LAYERDEPENDS_meta-harmonyOS = "core"
LAYERSERIES_COMPAT_meta-harmonyOS = "kirkstone"
```
